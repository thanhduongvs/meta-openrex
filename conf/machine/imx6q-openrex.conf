## conf/machine/imx6q-openrex.conf
```bitbake
#@TYPE: Machine
#@NAME: NXP i.MX6Q SABRE Smart Device
#@SOC: i.MX6Q
#@DESCRIPTION: Machine configuration for NXP i.MX6Q SABRE Smart Device
#@MAINTAINER: Otavio Salvador <otavio@ossystems.com.br>

require conf/machine/include/imx6openrex-common.inc

MACHINEOVERRIDES =. "mx6:mx6q:"

#PREFERRED_PROVIDER_u-boot = "u-boot-openrex"
#PREFERRED_PROVIDER_virtual/bootloader = "linux-openrex"
#PREFERRED_VERSION_linux-openrex ?= "4.1"


KERNEL_DEVICETREE = "imx6q-openrex.dtb"

UBOOT_CONFIG ??= "sd"
UBOOT_CONFIG[sd] = "mx6qopenrex_config,sdcard"
UBOOT_CONFIG[mfgtool] = "mx6qopenrex_config"
```
